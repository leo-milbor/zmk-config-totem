## config/west.yml
```yaml
manifest:
  remotes:
    - name: zmkfirmware
      url-base: https://github.com/zmkfirmware
    - name: englmaxi
      url-base: https://github.com/englmaxi
  projects:
    - name: zmk
      remote: zmkfirmware
      revision: 4de3133
      import: app/west.yml
    - name: zmk-dongle-display
      remote: englmaxi
      revision: 2bb333f
  self:
    path: config
```
